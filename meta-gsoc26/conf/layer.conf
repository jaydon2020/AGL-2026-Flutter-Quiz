## meta-gsoc26/conf/layer.conf
```bitbake
# We have a conf and classes directory, add to BBPATH
BBPATH .= ":${LAYERDIR}"

# We have recipes-* directories, add to BBFILES
BBFILES += "${LAYERDIR}/recipes-*/*/*.bb \\
            ${LAYERDIR}/recipes-*/*/*.bbappend"

BBFILE_COLLECTIONS += "meta-gsoc26"
BBFILE_PATTERN_meta-gsoc26 = "^${LAYERDIR}/"
BBFILE_PRIORITY_meta-gsoc26 = "70"

LAYERDEPENDS_meta-gsoc26 = "core meta-flutter"
LAYERSERIES_COMPAT_meta-gsoc26 = "scarthgap"
```
